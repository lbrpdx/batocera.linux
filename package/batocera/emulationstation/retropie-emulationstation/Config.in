## package/batocera/emulationstation/retropie-emulationstation/Config.in
```kconfig
config BR2_PACKAGE_RETROPIE_EMULATIONSTATION
	bool "RetroPie Emulationstation"
	depends on BR2_INSTALL_LIBSTDCPP
	select BR2_PACKAGE_SDL2
	select BR2_PACKAGE_SDL2_MIXER
	select BR2_PACKAGE_ALSA_LIB
	select BR2_PACKAGE_ALSA_UTILS_AMIXER
	depends on (BR2_PACKAGE_HAS_LIBGLES || BR2_PACKAGE_HAS_LIBGL)
	select BR2_PACKAGE_LIBFREEIMAGE
	select BR2_PACKAGE_FREETYPE
#	select BR2_PACKAGE_BOOST
#	select BR2_PACKAGE_BOOST_FILESYSTEM
#	select BR2_PACKAGE_BOOST_DATE_TIME
#	select BR2_PACKAGE_BOOST_REGEX
#	select BR2_PACKAGE_BOOST_LOCALE
#	select BR2_PACKAGE_BOOST_SYSTEM
#	select BR2_PACKAGE_BOOST_THREAD
	select BR2_PACKAGE_DEJAVU
	select BR2_PACKAGE_OPENSSL
	select BR2_PACKAGE_LIBCURL
	select BR2_PACKAGE_NANUM_FONT
	select BR2_PACKAGE_FPING
	select BR2_PACKAGE_VLC
	select BR2_PACKAGE_RAPIDJSON

	help
	  A multi emulator frontend.
	  https://github.com/Aloshi/EmulationStation

comment "Emulation station 2 needs a toolchain w/ C++, ALSA, Boost, GLES and SDL2"
	depends on !BR2_INSTALL_LIBSTDCPP || !BR2_PACKAGE_SDL2 || !BR2_PACKAGE_SDL2_MIXER || \
		!BR2_PACKAGE_BOOST || !BR2_PACKAGE_ALSA_LIB || \
		(!BR2_PACKAGE_HAS_LIBGLES || !BR2_PACKAGE_HAS_LIBGL)
```

## package/batocera/utils/espeak-ng/Config.in
```kconfig
config BR2_PACKAGE_ESPEAK_NG
    bool "espeak-ng"
    depends on BR2_INSTALL_LIBSTDCPP
    help
      eSpeak-ng is a more modern text-to-speech synthesizer for English
      and other languages, forked from the espeak project.
      
      https://github.com/espeak-ng/espeak-ng
```
